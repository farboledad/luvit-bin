## package/lang/luvi/Config.in
```kconfig
# luvi configuration
menu "Configuration"
	depends on PACKAGE_luvi

config LUVI_EXCLUDE_PCRE
	bool "Exclude PCRE"
	default y

config LUVI_EXCLUDE_LPEG
	bool "Exclude LPEG"
	default n

config LUVI_EXCLUDE_SSL
	bool "Exclude SSL"
	default n

config LUVI_EXCLUDE_ZLIB
	bool "Exclude zlib"
	default n

config LUVI_NO_LUVI
	bool "Do not install luvi binary (single file build)"
	default n

endmenu
```

## package/leveldb/Config.in
```kconfig
# leveldb configuration
menu "Configuration"
	depends on PACKAGE_leveldb

config LVLDB_TEST
	bool "Install test executables"
	default n

endmenu
```

## package/lora/Config.in
```kconfig
# lora configuration
menu "Configuration"
	depends on PACKAGE_lora

config LORA_TEST
	bool "Install test executables"
	default n

endmenu
```
